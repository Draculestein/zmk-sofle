## config/west.yml
```yaml
manifest:
  remotes:
    - name: zmkfirmware
      url-base: https://github.com/zmkfirmware
    - name: cormoran
      url-base: https://github.com/cormoran
    - name: a741 # Eyelash-sofle firmware provider
      url-base: https://github.com/a741725193
  projects:
    - name: zmk
      remote: cormoran
      revision: v0.3-branch+dya
      import: app/west.yml
    - name: zmk-sofle
      remote: a741
      revision: main
  self:
    path: config
```
